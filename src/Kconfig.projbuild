## src/Kconfig.projbuild
```kconfig
menu "Power Consumption"

    config ESP_POWER_MODE
        int "Energy mode"
        default 0
        range 0 1
        help
            0 - Energy saving
            1 - Performance

endmenu

menu "Wifi Config"

    config ESP_WIFI_SSID
        string "WiFi SSID"
        default "ssid"

    config ESP_WIFI_PASSWORD
        string "Wifi password"
        default ""

    config ESP_MAXIMUM_RETRY
        int "WiFi max amount of reconnection attempt"
        default 5
endmenu

menu "MQTT Config"
    config ESP_MQTT_URI
        string "MQTT Broker uri"
        default "mqtt://164.41.98.25"

    config ESP_MQTT_KEY
        string "Token"
        default "your token here"
endmenu
```
